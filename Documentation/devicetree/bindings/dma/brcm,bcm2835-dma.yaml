## Documentation/devicetree/bindings/dma/brcm,bcm2835-dma.yaml
```yaml
# SPDX-License-Identifier: (GPL-2.0-only OR BSD-2-Clause)
%YAML 1.2
---
$id: http://devicetree.org/schemas/dma/brcm,bcm2835-dma.yaml#
$schema: http://devicetree.org/meta-schemas/core.yaml#

title: BCM2835 DMA controller

maintainers:
  - Nicolas Saenz Julienne <nsaenz@kernel.org>

description: |
  The BCM2835 DMA controller has 16 channels in total.
  Only the lower 13 channels have an associated IRQ.
  Some arbitrary channels are used by the firmware
  (1,3,6,7 in the current firmware version).
  The channels 0,2 and 3 have special functionality
  and should not be used by the driver.

allOf:
  - $ref: "dma-controller.yaml#"

properties:
  compatible:
    const: brcm,bcm2835-dma

  reg:
    maxItems: 1

  interrupts:
    description:
      Should contain the DMA interrupts associated to the DMA channels in
      ascending order.
    minItems: 1
    maxItems: 16

  interrupt-names:
    minItems: 1
    maxItems: 16

  "#dma-cells":
    const: 1
    description: >
      DMA clients must use the format described in dma.txt, giving a phandle
      to the DMA controller while the second cell in the dmas property of the
      client device represents the DREQ number.

  brcm,dma-channel-mask:
    description:
      Bit mask representing the channels not used by the firmware in
      ascending order, i.e. first channel corresponds to LSB.
    $ref: /schemas/types.yaml#/definitions/uint32-array
    maxItems: 1

required:
  - compatible
  - reg
  - interrupts
  - "#dma-cells"
  - brcm,dma-channel-mask

additionalProperties: false

examples:
  - |
    dma: dma-controller@7e007000 {
      compatible = "brcm,bcm2835-dma";
      reg = <0x7e007000 0xf00>;
      interrupts = <1 16>,
                   <1 17>,
                   <1 18>,
                   <1 19>,
                   <1 20>,
                   <1 21>,
                   <1 22>,
                   <1 23>,
                   <1 24>,
                   <1 25>,
                   <1 26>,
                   /* dma channel 11-14 share one irq */
                   <1 27>,
                   <1 27>,
                   <1 27>,
                   <1 27>,
                   /* unused shared irq for all channels */
                   <1 28>;
      interrupt-names = "dma0",
                        "dma1",
                        "dma2",
                        "dma3",
                        "dma4",
                        "dma5",
                        "dma6",
                        "dma7",
                        "dma8",
                        "dma9",
                        "dma10",
                        "dma11",
                        "dma12",
                        "dma13",
                        "dma14",
                        "dma-shared-all";
        #dma-cells = <1>;
        brcm,dma-channel-mask = <0x7f35>;
    };

...
```

## Documentation/devicetree/bindings/gpu/brcm,bcm-v3d.yaml
```yaml
# SPDX-License-Identifier: GPL-2.0
%YAML 1.2
---
$id: http://devicetree.org/schemas/gpu/brcm,bcm-v3d.yaml#
$schema: http://devicetree.org/meta-schemas/core.yaml#

title: Broadcom V3D GPU Bindings

maintainers:
  - Eric Anholt <eric@anholt.net>
  - Nicolas Saenz Julienne <nsaenzjulienne@suse.de>

properties:
  $nodename:
    pattern: '^gpu@[a-f0-9]+$'

  compatible:
    enum:
      - brcm,7268-v3d
      - brcm,7278-v3d

  reg:
    items:
      - description: hub register
      - description: core0 register
      - description: GCA cache controller register (if GCA controller)
      - description: bridge register (if no external reset controller)
    minItems: 2
    maxItems: 4

  reg-names:
    items:
      enum: [ bridge, core0, gca, hub ]
    minItems: 2
    maxItems: 4

  interrupts:
    items:
      - description: hub interrupt
      - description: core interrupt (if it don't share the hub's interrupt)
    minItems: 1
    maxItems: 2

  clocks:
    maxItems: 1

  clock-names:
    maxItems: 1

  resets:
    maxItems: 1

  power-domains:
    maxItems: 1

required:
  - compatible
  - reg
  - interrupts

additionalProperties: false

examples:
  - |
    v3d {
      compatible = "brcm,7268-v3d";
      reg = <0xf1204000 0x100>,
            <0xf1200000 0x4000>,
            <0xf1208000 0x4000>,
            <0xf1204100 0x100>;
      reg-names = "bridge", "hub", "core0", "gca";
      interrupts = <0 78 4>,
                   <0 77 4>;
    };

...
```

## Documentation/devicetree/bindings/media/i2c/ovti,ov1063x.yaml
```yaml
# SPDX-License-Identifier: (GPL-2.0-only OR BSD-2-Clause)
%YAML 1.2
---
$id: http://devicetree.org/schemas/media/i2c/ovti,ov1063x.yaml#
$schema: http://devicetree.org/meta-schemas/core.yaml#

title: OmniVision OV10633/OV1035 Camera Sensor

maintainers:
  - Laurent Pinchart <laurent.pinchart@ideasonboard.com>

description: |-
  The OmniVision OV1063x is a 720p camera sensor which supports resolutions up
  to 1280x800 and 8- and 10-bit YUV output formats.

properties:
  compatible:
    enum:
      - ovti,ov10633
      - ovti,ov10635

  reg:
    maxItems: 1

  clocks:
    maxItems: 1

  clock-names:
    const: xvclk

  reset-gpios:
    maxItems: 1
    description:
      Specifier for the GPIO connected to the RESETB pin.

  powerdown-gpios:
    maxItems: 1
    description:
      Specifier for the GPIO connected to the PWDN pin.

  port:
    $ref: /schemas/graph.yaml#/$defs/port-base
    additionalProperties: false

    properties:
      endpoint:
        $ref: /schemas/media/video-interfaces.yaml#
        unevaluatedProperties: false

        properties:
          hsync-active: true
          vsync-active: true
          pclk-sample: true
          bus-width:
            enum: [ 8, 10 ]

required:
  - compatible
  - reg
  - clocks
  - clock-names
  - port

additionalProperties: false

examples:
  - |
    #include <dt-bindings/gpio/gpio.h>

    i2c {
        clock-frequency = <400000>;
        #address-cells = <1>;
        #size-cells = <0>;

        camera@37 {
            compatible = "ovti,ov10633";
            reg = <0x37>;

            clocks = <&fixed_clock>;
            clock-names = "xvclk";

            reset-gpios = <&gpio4 17 GPIO_ACTIVE_HIGH>;
            powerdown-gpios = <&gpio5 11 GPIO_ACTIVE_HIGH>;

            port {
                camera1: endpoint {
                     remote-endpoint = <&vin1a_ep>;
                     hsync-active = <1>;
                     vsync-active = <1>;
                     pclk-sample = <0>;
                     bus-width = <8>;
                };
            };
        };
    };

...
```

## Documentation/devicetree/bindings/nvmem/raspberrypi,bcm2835-customer-otp.txt
```
Customer OTP Memory for Raspberry Pi

The VC4 firmware exposes a mailbox interface that allows the ARM core
to access the customer part of the OTP memory.

The OTP node must be a child node of the Raspberry Pi firmware node.

Required properties :
- compatible     : Should be "raspberrypi,bcm2835-customer-otp"

See nvmem.txt for more information.

Example:

firmware: firmware-rpi {
	compatible = "raspberrypi,bcm2835-firmware";
	mboxes = <&mailbox>;

	customer_otp: otp {
		compatible = "raspberrypi,bcm2835-customer-otp";
	};
};
```

## Documentation/devicetree/bindings/phy/brcm-bcm2835-usb2-phy.txt
```
Broadcom BCM2835 USB 2.0 PHY

Required properties:
 - compatible: brcm,bcm2835-phy
 - #phy-cells: must be 0
Refer to phy/phy-bindings.txt for the generic PHY binding properties

Example:

	usbphy: phy {
		compatible = "brcm,bcm2835-phy";
		#phy-cells = <0>;
	};
```

## Documentation/devicetree/bindings/pwm/pwm-gpio.yaml
```yaml
# SPDX-License-Identifier: (GPL-2.0-only OR BSD-2-Clause)
%YAML 1.2
---
$id: http://devicetree.org/schemas/pwm/pwm-gpio.yaml#
$schema: http://devicetree.org/meta-schemas/core.yaml#

title: GPIO-based PWM

maintainers:
  - Vincent Whitchurch <vincent.whitchurch@axis.com>

properties:
  compatible:
    enum:
      - pwm-gpio

  "#pwm-cells":
    const: 2

  gpios:
    maxItems: 1
    description: GPIO to toggle.

required:
  - compatible
  - "#pwm-cells"
  - gpio

additionalProperties: false

examples:
  - |
    #include <dt-bindings/gpio/gpio.h>

    pwm0 {
        #pwm-cells = <2>;
        compatible = "pwm-gpio";
        gpios = <&gpio 1 GPIO_ACTIVE_HIGH>;
    };
```
